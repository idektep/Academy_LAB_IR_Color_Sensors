//------------------------------------------------------------------------------color_sensor Function-----------------------------------------------------------------------//
void color_sensor() {
  sub_color();
  //Print Color Value here
  Serial.print("red: ");
  Serial.print(new_red);
  Serial.print(" green: ");
  Serial.print(new_green);
  Serial.print(" blue: ");
  Serial.print(new_blue);
    //-----------------------------------------------------------------------------------------------------------------------------------------------------//
    if ((new_red > 40) && (new_green > 10) && (new_blue < 20)) {

      // ██╗   ██╗███████╗██╗     ██╗      ██████╗ ██╗    ██╗    ███████╗██████╗ ██╗████████╗    ██╗  ██╗███████╗██████╗ ███████╗
      // ╚██╗ ██╔╝██╔════╝██║     ██║     ██╔═══██╗██║    ██║    ██╔════╝██╔══██╗██║╚══██╔══╝    ██║  ██║██╔════╝██╔══██╗██╔════╝
      //  ╚████╔╝ █████╗  ██║     ██║     ██║   ██║██║ █╗ ██║    █████╗  ██║  ██║██║   ██║       ███████║█████╗  ██████╔╝█████╗
      //   ╚██╔╝  ██╔══╝  ██║     ██║     ██║   ██║██║███╗██║    ██╔══╝  ██║  ██║██║   ██║       ██╔══██║██╔══╝  ██╔══██╗██╔══╝
      //    ██║   ███████╗███████╗███████╗╚██████╔╝╚███╔███╔╝    ███████╗██████╔╝██║   ██║       ██║  ██║███████╗██║  ██║███████╗
      //    ╚═╝   ╚══════╝╚══════╝╚══════╝ ╚═════╝  ╚══╝╚══╝     ╚══════╝╚═════╝ ╚═╝   ╚═╝       ╚═╝  ╚═╝╚══════╝╚═╝  ╚═╝╚══════╝
      Serial.println("Detect Yellow");  // edit here
      delay(300);
    }
    //-----------------------------------------------------------------------------------------------------------------------------------------------------//
    else if (new_red > 80 && new_red > new_green && new_red > new_blue) {

      // ██████╗ ███████╗██████╗     ███████╗██████╗ ██╗████████╗    ██╗  ██╗███████╗██████╗ ███████╗
      // ██╔══██╗██╔════╝██╔══██╗    ██╔════╝██╔══██╗██║╚══██╔══╝    ██║  ██║██╔════╝██╔══██╗██╔════╝
      // ██████╔╝█████╗  ██║  ██║    █████╗  ██║  ██║██║   ██║       ███████║█████╗  ██████╔╝█████╗
      // ██╔══██╗██╔══╝  ██║  ██║    ██╔══╝  ██║  ██║██║   ██║       ██╔══██║██╔══╝  ██╔══██╗██╔══╝
      // ██║  ██║███████╗██████╔╝    ███████╗██████╔╝██║   ██║       ██║  ██║███████╗██║  ██║███████╗
      // ╚═╝  ╚═╝╚══════╝╚═════╝     ╚══════╝╚═════╝ ╚═╝   ╚═╝       ╚═╝  ╚═╝╚══════╝╚═╝  ╚═╝╚══════╝
      Serial.println("Detect red");  //edit here
      delay(300);
    }
  //-----------------------------------------------------------------------------------------------------------------------------------------------------//
 else if ((new_green > 30) && (new_green > new_red) && (new_green > new_blue)) {

    //  ██████╗ ██████╗ ███████╗███████╗███╗   ██╗    ███████╗██████╗ ██╗████████╗    ██╗  ██╗███████╗██████╗ ███████╗
    // ██╔════╝ ██╔══██╗██╔════╝██╔════╝████╗  ██║    ██╔════╝██╔══██╗██║╚══██╔══╝    ██║  ██║██╔════╝██╔══██╗██╔════╝
    // ██║  ███╗██████╔╝█████╗  █████╗  ██╔██╗ ██║    █████╗  ██║  ██║██║   ██║       ███████║█████╗  ██████╔╝█████╗
    // ██║   ██║██╔══██╗██╔══╝  ██╔══╝  ██║╚██╗██║    ██╔══╝  ██║  ██║██║   ██║       ██╔══██║██╔══╝  ██╔══██╗██╔══╝
    // ╚██████╔╝██║  ██║███████╗███████╗██║ ╚████║    ███████╗██████╔╝██║   ██║       ██║  ██║███████╗██║  ██║███████╗
    //  ╚═════╝ ╚═╝  ╚═╝╚══════╝╚══════╝╚═╝  ╚═══╝    ╚══════╝╚═════╝ ╚═╝   ╚═╝       ╚═╝  ╚═╝╚══════╝╚═╝  ╚═╝╚══════╝

    Serial.println("Detect green");  //edit here
    delay(300);
  }
  //-----------------------------------------------------------------------------------------------------------------------------------------------------//
  else if ((new_blue > 60) && (new_blue > new_red) && (new_blue > new_green)) {
    ///////////////////////////////////////////////////////////
    // ██████╗ ██╗     ██╗   ██╗███████╗    ███████╗██████╗ ██╗████████╗    ██╗  ██╗███████╗██████╗ ███████╗
    // ██╔══██╗██║     ██║   ██║██╔════╝    ██╔════╝██╔══██╗██║╚══██╔══╝    ██║  ██║██╔════╝██╔══██╗██╔════╝
    // ██████╔╝██║     ██║   ██║█████╗      █████╗  ██║  ██║██║   ██║       ███████║█████╗  ██████╔╝█████╗
    // ██╔══██╗██║     ██║   ██║██╔══╝      ██╔══╝  ██║  ██║██║   ██║       ██╔══██║██╔══╝  ██╔══██╗██╔══╝
    // ██████╔╝███████╗╚██████╔╝███████╗    ███████╗██████╔╝██║   ██║       ██║  ██║███████╗██║  ██║███████╗
    // ╚═════╝ ╚══════╝ ╚═════╝ ╚══════╝    ╚══════╝╚═════╝ ╚═╝   ╚═╝       ╚═╝  ╚═╝╚══════╝╚═╝  ╚═╝╚══════╝

    Serial.println("Detect blue");  //edit here
    delay(300);
  } 
   //----- Detect white ------//
  else if ((new_red <= 40) && (new_green <= 40) && (new_blue <= 40)) {
    //-white-
    Serial.println("Detect white");  //edit here
    delay(300);
  }
  //-----------------------------------------------------------------------------------------------------------------------------------------------------//
}
